## tests/ztest_app_config/testcase.yaml
```yaml
tests:
  - name: app_config
    description: Validate Kconfig/DT precedence
    build: true
    requires:
      - build
```

## tests/ztest_ble_codec/testcase.yaml
```yaml
tests:
  - name: ble_codec
    description: Validate LE encoding/decoding
    build: true
    requires:
      - build
```
